## sdkconfig.defaults
```kconfig
# BLE - NimBLE
CONFIG_BT_ENABLED=y
CONFIG_BT_NIMBLE_ENABLED=y
CONFIG_BT_NIMBLE_ROLE_PERIPHERAL=y
CONFIG_BT_NIMBLE_ROLE_CENTRAL=n
CONFIG_BT_NIMBLE_ROLE_OBSERVER=n
CONFIG_BT_NIMBLE_ROLE_BROADCASTER=n

# Debug optimisation
CONFIG_COMPILER_OPTIMIZATION_DEBUG=y

# Flash
CONFIG_ESPTOOLPY_FLASHSIZE_4MB=y

# Power Management
CONFIG_PM_ENABLE=y
#CONFIG_PM_DFS_INIT_AUTO=y

# FreeRTOS tickless idle (required for automatic light sleep)
CONFIG_FREERTOS_USE_TICKLESS_IDLE=y

# BLE controller modem sleep
CONFIG_BT_CTRL_MODEM_SLEEP=y
CONFIG_BT_CTRL_MODEM_SLEEP_MODE_1=y
CONFIG_BT_CTRL_SLEEP_MODE_EFF=1
CONFIG_BT_CTRL_SLEEP_CLOCK_EFF=1
CONFIG_BT_CTRL_MAIN_XTAL_PU_DURING_LIGHT_SLEEP=y

# Use main XTAL as BLE low-power clock (no 32kHz crystal)
CONFIG_BT_CTRL_LPCLK_SEL_MAIN_XTAL=y

# BMX280 new I2C master driver
CONFIG_USE_I2C_MASTER_DRIVER=y 
```
